/dts-v1/;
/plugin/;

/ {
	compatible = "allwinner,sun8i-h3";

	pps {
		compatible = "pps-gpio";
		pinctrl-names = "default";
		pinctrl-0 = <&pps_pins>;
		gpios = <&pio 3 14 0>; /* PD14 */
		status = "okay";
	};
};

&pio {
	pps_pins: pps_pins {
		pins = "PD14";
		function = "gpio_in";
	};
};

