/dts-v1/;
/plugin/;

/ {
	compatible = "allwinner,sun8i-h3";

	aliases {
		serial1 = "/soc/serial@01c28400";
	};
};

&uart1 {
	pinctrl-names = "default";
	pinctrl-0 = <&uart1_pins>;
	status = "okay";
};
