/dts-v1/;
/plugin/;

/ {
	compatible = "allwinner,sun8i-h3";

	onewire {
		compatible = "w1-gpio";
		pinctrl-names = "default";
		pinctrl-0 = <&w1_pins>;
		gpios = <&pio 3 14 0>; /* PD14 */
		status = "okay";
	};
};

&pio {
	w1_pins: w1_pins {
		pins = "PD14";
		function = "gpio_in";
	};
};
