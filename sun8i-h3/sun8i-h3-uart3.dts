/dts-v1/;
/plugin/;

/ {
	compatible = "allwinner,sun8i-h3";

	aliases {
		serial3 = "/soc/serial@01c28c00";
	};
};

&uart3 {
	pinctrl-names = "default";
	pinctrl-0 = <&uart3_pins>;
	status = "okay";
};

