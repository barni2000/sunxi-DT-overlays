/dts-v1/;
/plugin/;

/ {
	compatible = "allwinner,sun8i-h3";

	aliases {
		serial2 = "/soc/serial@01c28800";
	};
};

&uart2 {
	pinctrl-names = "default";
	pinctrl-0 = <&uart2_pins>;
	status = "okay";
};
